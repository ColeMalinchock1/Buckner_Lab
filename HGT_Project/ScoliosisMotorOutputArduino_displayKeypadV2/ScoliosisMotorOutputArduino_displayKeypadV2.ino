// ScoliosisMotorOutputArduino_displayKeypadV2
// Edward Katz
// 7/3/2023

// Multiple opensource libraries are used in this project, you will need to add them to your workspace before it runs.
//  U8g2 library exists in Arduino's database. Use Tools->Manage Libraries.
//    Search U8g2; install the "U8g2" library by Oliver.
//  Keypad library exists in Arduino's database. Use Tools->Manage Libraries.
//    Search Keypad; install the "Keypad" library by Mark Stanley, Alexander Brevig (may be a few entries down in the list).


#include <Arduino.h>
#include <U8g2lib.h>

#include <Keypad.h>

#ifdef U8X8_HAVE_HW_SPI
#include <SPI.h>
#endif
#ifdef U8X8_HAVE_HW_I2C
#include <Wire.h>
#endif

#include <stdio.h>
#include <stdlib.h>

// NCSU MAE Logo Bitmap startup splash screen
// version 1

#define u8g_MAElogo_width 128
#define u8g_MAElogo_height 64

static unsigned char u8g_MAElogo_bits[] = {
 0xff,0xff,0xff,0xff,0xff,0xff,0xff,0xff,0xff,0xff,0xff,0xff,0xff,0xff,0xff,
 0xff,0xff,0xff,0xff,0xff,0xff,0xff,0xff,0xff,0xff,0xff,0xff,0xff,0xff,0xff,
 0xff,0xff,0xff,0xff,0xff,0xff,0xff,0xff,0xff,0xff,0xff,0xff,0xff,0xff,0xff,
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 0xff,0xff,0xff,0xff };

//
//
const byte ROWS = 4; // defines the four keypad rows
const byte COLS = 4; // defines the four keypad columns
//define the cymbols on the buttons of the keypads
char hexaKeys[ROWS][COLS] = { // defines each button on the keypad in CHAR form
  {'1','2','3','A'},
  {'4','5','6','B'},
  {'7','8','9','C'},
  {'*','0','#','D'}
};
byte rowPins[ROWS] = {30, 32, 34, 36}; //connect to the row pinouts of the keypad 
byte colPins[COLS] = {31, 33, 35, 37}; //connect to the column pinouts of the keypad

// When Keypad is facing you, pinout from left to right on Arduino Mega:
// (30/D30/PC/A15), (32/D32/PC5/A13), (34/D34/PC3/A11), (36/D36/PC1/A9),
// (31/D31/PC6/A14), (33/D33/PC4/A12), (35/D35/PC2/A10), (37/D37/PC0/A8)


//initialize an instance of class NewKeypad
Keypad customKeypad = Keypad(makeKeymap(hexaKeys), rowPins, colPins, ROWS, COLS); 

// Pin to take input from load cell
const int inputPin = A0; // Analogue input (A0/PF0/ADC[0])
// Two pinouts to motor
const int abovePin = 22; // Direction pin (22/D22/PA0/AD0)
const int belowPin = 24; // Direction pin (24/D24/PA2/AD2)

double setWeight = 0; // variable for desired weight for applied pressure
double setVoltage = 0; // variable for desired voltage from weight

// 128x64 OLED I2C display setup. See File->examples->U8G2->Full Buffer->Hello World (or any other program) to see other examples listed.
U8G2_SSD1306_128X64_NONAME_F_HW_I2C u8g2(U8G2_R0, /* reset=*/ U8X8_PIN_NONE);

bool systemStartup = true;
bool systemStartupSplashscreen = true;

void setup() { // Setup to run once; initiates pinouts, serial connection, and u8g2

  pinMode(abovePin, OUTPUT);
  pinMode(belowPin, OUTPUT);
  digitalWrite(abovePin, LOW);
  digitalWrite(belowPin, LOW);
  Serial.begin(9600);

  u8g2.begin();
  
  u8g2.setFontRefHeightExtendedText();
  u8g2.setDrawColor(1);
  u8g2.setFontPosTop();
  u8g2.setFontDirection(0);

}

///////////////////////////////////////////////

void loop() { // Main code loop

//GET ANALOG INPUT
  int sensorValue = analogRead(inputPin);
  float voltage = sensorValue * (5.0 / 1023.0); // Convert ADC value to voltage

  double weight = ((voltage - 4.9874) / -0.0966); // conversion from weight to volts, derived from load cell calibration data

  u8g2.clearBuffer();

  if (systemStartupSplashscreen == true){
    u8g2.clearBuffer();
    u8g2.drawXBM( 0, 0, u8g_MAElogo_width, u8g_MAElogo_height, u8g_MAElogo_bits);
    u8g2.sendBuffer();
    delay(5000);
    u8g2.clearBuffer();
    systemStartupSplashscreen = false;
  }


// SCREEN UPDATING
  char customKey = customKeypad.getKey();

  //EDITING SETWEIGHT WITH NUMBERPAD
  if ((customKey == '#') || (systemStartup == true)){
    int digitPlace = 1; // which place digit you are editing; when user types, this goes up by one (first editing 1s place, then the tenths place, then hundredths place)
    double newSetWeight = 0;
    double newKeypadDouble = 0;
    digitalWrite(abovePin, LOW);
    digitalWrite(belowPin, LOW);
    char newSetWeightBuffer[6];
    while (digitPlace < 4){
      char customKey = customKeypad.getKey();
      if (customKey){
        if (customKey == '1'){newKeypadDouble = 1; digitPlace++;}
        if (customKey == '2'){newKeypadDouble = 2; digitPlace++;}
        if (customKey == '3'){newKeypadDouble = 3; digitPlace++;}
        if (customKey == '4'){newKeypadDouble = 4; digitPlace++;}
        if (customKey == '5'){newKeypadDouble = 5; digitPlace++;}
        if (customKey == '6'){newKeypadDouble = 6; digitPlace++;}
        if (customKey == '7'){newKeypadDouble = 7; digitPlace++;}
        if (customKey == '8'){newKeypadDouble = 8; digitPlace++;}
        if (customKey == '9'){newKeypadDouble = 9; digitPlace++;}
        if (customKey == '0'){newKeypadDouble = 0; digitPlace++;}
        newSetWeight = (newSetWeight + (newKeypadDouble/(0.01*(pow(10, (digitPlace-1))))));
      }

      dtostrf(newSetWeight, -3 /*min width, left justified*/, 1 /*characters after decimal*/, newSetWeightBuffer /* buffer to store*/);

      u8g2.setCursor(0,0);
      u8g2.setFont(u8g2_font_lubB10_te);
      u8g2.print("set weight:");
      u8g2.setCursor(0, 15);
      u8g2.setFont(u8g2_font_fub30_tf);
      if (newSetWeight < 10){u8g2.print("0");}
      u8g2.print(newSetWeightBuffer);
      u8g2.print("lb");
      u8g2.setCursor(0, 20);
      if (digitPlace == 1){u8g2.print("_  ");}
      if (digitPlace == 2){u8g2.print("  _ ");}
      if (digitPlace == 3){u8g2.print("     _");}
      u8g2.sendBuffer();
      u8g2.clearBuffer();

      // Confirming user input data
      bool confirmed = false;
      bool cancelled = false;
      if (digitPlace == 4){
        while ((confirmed == false) && (cancelled == false)){
          u8g2.setCursor(0,0);
          u8g2.setFont(u8g2_font_lubB10_te);
          u8g2.print("Confirm change?");
          u8g2.setCursor(0,15);
          u8g2.print("* cancel|# confirm");
          u8g2.setCursor(0, 30);
          u8g2.setFont(u8g2_font_fub30_tf);
          u8g2.print(newSetWeightBuffer);
          u8g2.print("lb");
          u8g2.sendBuffer();
          u8g2.clearBuffer();

          char customKey = customKeypad.getKey();
          if (customKey == '*'){
            u8g2.setCursor(0,0);
            u8g2.setFont(u8g2_font_lubB10_te);
            u8g2.print("Cancelled.");
            u8g2.setCursor(0, 15);
            u8g2.setFont(u8g2_font_fub30_tf);
            u8g2.print(newSetWeightBuffer);
            u8g2.print("lb");
            u8g2.sendBuffer();
            u8g2.clearBuffer();

            cancelled = true;
            if (systemStartup == true){digitPlace = 1;} // resets digitPlace in case of cancel on startup
            newSetWeight = 0;
            newKeypadDouble = 0;

            delay(2000);

          }
          if (customKey == '#'){
            u8g2.setCursor(0,0);
            u8g2.setFont(u8g2_font_lubB10_te);
            u8g2.print("Weight set.");
            u8g2.setCursor(0, 15);
            u8g2.setFont(u8g2_font_fub30_tf);
            u8g2.print(newSetWeightBuffer);
            u8g2.print("lb");
            u8g2.sendBuffer();
            u8g2.clearBuffer();

            confirmed = true;

            delay(2000);
          }
        } // while 
      } // if digitplace = 4
    } // while digitplace < 4

    setWeight = newSetWeight;
    setVoltage = (-0.0966*setWeight) + 4.9874; // conversion from weight to volts, derived from load cell calibration data
    systemStartup = false;
    
  } //if ((customKey == '#') || (systemStartup == true)){



  int counter = 0;

  if (customKey && customKey != '#'){
    while (counter < 20){ // counter used as a kind of timer for the set weight screen
      // EMERGENCY STOP WITH D
      bool emergStop = false;
      if (customKey == 'D'){
        digitalWrite(abovePin, LOW);
        digitalWrite(belowPin, LOW);
        emergStop = true;
        u8g2.setCursor(0,0);
        u8g2.setFont(u8g2_font_lubB10_te);
        u8g2.print("Press D to restart");
        u8g2.setCursor(0, 15);
        u8g2.setFont(u8g2_font_fub30_tf);
        u8g2.print("STOP");
        u8g2.sendBuffer();
        u8g2.clearBuffer();
        delay (1000);
        while (emergStop == true){
          char customKey = customKeypad.getKey();
          if (customKey == 'D'){
            emergStop = false;
            u8g2.setCursor(0,0);
            u8g2.setFont(u8g2_font_lubB10_te);
            u8g2.print("Restarting...");
            u8g2.setCursor(0, 15);
            u8g2.setFont(u8g2_font_fub30_tf);
            u8g2.print("STOP");
            u8g2.sendBuffer();
            delay(1000);
            u8g2.clearBuffer();
            counter = 20;
          }
        }
      } // if customkey == D

      digitalWrite(abovePin, LOW);
      digitalWrite(belowPin, LOW);

      // drawing the setweight screen
      char setWeightBuffer[6];
      dtostrf(setWeight, -3 /*min width, left justified*/, 1 /*characters after decimal*/, setWeightBuffer /* buffer to store*/);
      
      u8g2.setCursor(0,0);
      u8g2.setFont(u8g2_font_lubB10_te);
      u8g2.print("set weight:");
      u8g2.setCursor(0, 15);
      u8g2.setFont(u8g2_font_fub30_tf);
      u8g2.print(setWeightBuffer);
      u8g2.print("lb");

      u8g2.sendBuffer();
      u8g2.clearBuffer();
      counter++; // adding to timer
      char customKey = customKeypad.getKey(); // calls customKey again

      //EDITING SETVOLTAGE WITH A AND B
      if (customKey == 'A'){
        setWeight = (setWeight + 0.5);
        setVoltage = (-0.0966*setWeight) + 4.9874; // conversion from weight to volts, derived from load cell calibration data
        counter = 0;
      }
      if (customKey == 'B'){
        setWeight = (setWeight - 0.5);
        setVoltage = (-0.0966*setWeight) + 4.9874; // conversion from weight to volts, derived from load cell calibration data
        counter = 0;
      }
    } // while (counter < 20)
  } // if (customKey && customKey != '#')

  else{
    char weightBuffer[6];
    dtostrf(weight, -3 /*min width, left justified*/, 1 /*characters after decimal*/, weightBuffer /* buffer to store*/);

    u8g2.setCursor(0,0);
    u8g2.setFont(u8g2_font_lubB10_te);
    u8g2.print("current weight:");
    u8g2.setCursor(0,15);
    u8g2.setFont(u8g2_font_fub30_tf);
    u8g2.print(weightBuffer);
    u8g2.print("lb");
  }

  u8g2.sendBuffer(); 


//PIN OUTPUT:
  if (voltage < (setVoltage - 0.20)) { // loosens cable if voltage is too high
    digitalWrite(abovePin, HIGH);
    digitalWrite(belowPin, LOW);
  } else if (voltage > (setVoltage + 0.20)) { // tightens cable is voltage is too low
    digitalWrite(abovePin, LOW);
    digitalWrite(belowPin, HIGH);
  } else { // does nothing if voltage = setVoltage (+-0.02)
    digitalWrite(abovePin, LOW);
    digitalWrite(belowPin, LOW);
  }

  delay(50);

} // main loop

